## sdkconfig.defaults
```kconfig
# MimiClaw - Common Default Configuration

# Network hostname
CONFIG_LWIP_LOCAL_HOSTNAME="mimiclaw"
```

## sdkconfig.defaults.esp32c3
```kconfig
# MimiClaw - ESP32-C3 Target Configuration
# ESP32-C3: RISC-V single-core, 400KB SRAM, NO PSRAM, 4MB Flash typical
CONFIG_IDF_TARGET="esp32c3"

# Flash 4MB + DIO (standard for most C3 boards)
CONFIG_ESPTOOLPY_FLASHSIZE_4MB=y
CONFIG_ESPTOOLPY_FLASHMODE_DIO=y

# CPU 160MHz (max for C3)
CONFIG_ESP_DEFAULT_CPU_FREQ_MHZ_160=y

# NO PSRAM — disable all SPIRAM features
# CONFIG_SPIRAM is not set

# WiFi memory optimization (C3 needs more conservative settings)
CONFIG_ESP_WIFI_STATIC_RX_BUFFER_NUM=3
CONFIG_ESP_WIFI_DYNAMIC_RX_BUFFER_NUM=6
CONFIG_ESP_WIFI_RX_BA_WIN=3
CONFIG_LWIP_TCPIP_RECVMBOX_SIZE=12

# TLS: smaller buffers to fit in internal SRAM
# C3 uses internal SRAM for everything — reduce aggressively
CONFIG_MBEDTLS_DYNAMIC_FREE_CONFIG_DATA=y
CONFIG_MBEDTLS_SSL_IN_CONTENT_LEN=8192
CONFIG_MBEDTLS_SSL_OUT_CONTENT_LEN=4096

# WebSocket support
CONFIG_HTTPD_WS_SUPPORT=y

# Custom partition table (4MB layout)
CONFIG_PARTITION_TABLE_CUSTOM=y
CONFIG_PARTITION_TABLE_CUSTOM_FILENAME="partitions_c3.csv"

# Console: USB Serial/JTAG (C3 has native USB-JTAG, no UART0 needed)
CONFIG_ESP_CONSOLE_UART_DEFAULT=y
CONFIG_ESP_CONSOLE_UART_NUM=0
CONFIG_ESP_CONSOLE_UART_BAUDRATE=115200

# FreeRTOS: C3 is single-core (no core pinning)
# Tasks will be scheduled on the single RISC-V core
CONFIG_FREERTOS_UNICORE=y

# Stack size reduction for single-core
CONFIG_ESP_MAIN_TASK_STACK_SIZE=4096

# MbedTLS Memory Optimizations for C3 (Single Core, No PSRAM)
CONFIG_MBEDTLS_DYNAMIC_BUFFER=y
CONFIG_MBEDTLS_DYNAMIC_FREE_PEER_CERT=y
CONFIG_MBEDTLS_DYNAMIC_FREE_CONFIG_DATA=y
CONFIG_MBEDTLS_SSL_MAX_CONTENT_LEN=8192
CONFIG_MBEDTLS_SSL_IN_CONTENT_LEN=8192
CONFIG_MBEDTLS_SSL_OUT_CONTENT_LEN=2048
CONFIG_ESP_TLS_CLIENT_SESSION_TICKETS=y
CONFIG_COMPILER_OPTIMIZATION_SIZE=y

# TLS Certificate Validation Bypassing (Critical for C3 Memory limits)
CONFIG_ESP_TLS_INSECURE=y
CONFIG_ESP_TLS_SKIP_SERVER_CERT_VERIFY=y

# MbedTLS AES Optimizations (Fix esp-aes alloc failure)
CONFIG_MBEDTLS_HARDWARE_AES=n
CONFIG_MBEDTLS_HARDWARE_SHA=n
CONFIG_ESP_TLS_CLIENT_SESSION_TICKETS=n
```
